## config/boards/shields/bubble-bobbler/Kconfig.defconfig
```kconfig
if SHIELD_BUBBLE-BOBBLER_LEFT

config ZMK_KEYBOARD_NAME
    default "Bubble Bobbler"

config ZMK_SPLIT_ROLE_CENTRAL
    default y

endif

if SHIELD_BUBBLE-BOBBLER_LEFT || SHIELD_BUBBLE-BOBBLER_RIGHT

config ZMK_SPLIT
    default y

endif
```

## config/boards/shields/bubble-bobbler/Kconfig.shield
```kconfig
config SHIELD_BUBBLE-BOBBLER_LEFT
    def_bool $(shields_list_contains,bubble-bobbler_left)

config SHIELD_BUBBLE-BOBBLER_RIGHT
    def_bool $(shields_list_contains,bubble-bobbler_right)
```
